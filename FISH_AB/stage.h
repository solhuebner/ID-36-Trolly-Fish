#ifndef STAGE_H
#define STAGE_H

#include <Arduino.h>

#include "enemies.h"

#define MAX_ENEMIES               9
#define SPAWN_DELAY               160
#define SCORE_SMALL_FONT          0
#define SCORE_BIG_FONT            1


extern Physics physics;
extern unsigned long scorePlayer;
extern byte eelMax;
extern byte jellyMax;



#define PU_TURNFISH     0
#define PU_STOPFISH     1
#define PU_POPFISH      2
#define PU_SHOOTFISH    3
#define PU_PROTECTFISH  4
#define PU_LIFEFISH     5
#define PU_SHOCKFISH    6
#define PU_MAGNETFISH   7

#define PU_ON           1
#define PU_OFF          0

extern void setPowerup(byte index, byte state);
extern byte getPowerup(byte index);
extern void createPowerUp(byte type);

extern byte pu_shocks;
extern byte pu_bubbles;
//extern struct PowerUp;
//extern PowerUp bubbleBullet;

byte seaWeedFrames = 0;
byte seaWeedFrames2 = 3;

PROGMEM const unsigned char numbersSmall_plus_mask[] = {
// width, height
8, 8,
// number 0
0x00, 0x7C, 0x7C, 0xFE, 0xFE, 0xFF, 0xC7, 0xFF, 
0xE3, 0xFF, 0x7F, 0xFF, 0x3E, 0x7F, 0x00, 0x3E, 
// number 1
0x00, 0x00, 0x00, 0x06, 0x06, 0xCF, 0xC6, 0xFF, 
0xFF, 0xFF, 0xFF, 0xFF, 0x07, 0xFF, 0x00, 0x07, 
// number 2
0x00, 0xC0, 0xC0, 0xE6, 0xE6, 0xFF, 0xF7, 0xFF, 
0xFB, 0xFF, 0xDF, 0xFF, 0x0E, 0xDF, 0x00, 0x0E, 
// number 3
0x00, 0x00, 0x00, 0x42, 0x42, 0xE7, 0xE7, 0xFF, 
0xDB, 0xFF, 0xFF, 0xFF, 0x7E, 0xFF, 0x00, 0x7E, 
// number 4
0x00, 0x60, 0x60, 0xF8, 0x78, 0xFE, 0x7E, 0xFF, 
0xE7, 0xFF, 0xFF, 0xFF, 0x67, 0xFF, 0x00, 0x67, 
// number 5
0x00, 0x00, 0x00, 0x50, 0x50, 0xFF, 0xDF, 0xFF, 
0xDF, 0xFF, 0xFB, 0xFF, 0x73, 0xFF, 0x00, 0x73, 
// number 6
0x00, 0x70, 0x70, 0xF8, 0xF8, 0xFE, 0xCE, 0xFF, 
0xCF, 0xFF, 0x7F, 0xFF, 0x79, 0xFF, 0x00, 0x79, 
// number 7
0x00, 0x80, 0x80, 0xC3, 0xC3, 0xF7, 0xF3, 0xFF, 
0x7F, 0xFF, 0x1F, 0x7F, 0x07, 0x1F, 0x00, 0x07, 
// number 8
0x00, 0x70, 0x70, 0xFF, 0xFE, 0xFF, 0xDF, 0xFF, 
0xCB, 0xFF, 0xFF, 0xFF, 0x7E, 0xFF, 0x00, 0x7E, 
// number 9
0x00, 0x00, 0x00, 0x9E, 0x9E, 0xFF, 0xDF, 0xFF, 
0xF3, 0xFF, 0x3F, 0xFF, 0x1E, 0x3F, 0x00, 0x1E, 
};


PROGMEM const unsigned char numbersBig[] = {
  // width, height
  8, 16,
  // number 0
  0xE0, 0xFC, 0x3E, 0x0F, 0x07, 0x0F, 0xFF, 0xFE,
  0x3F, 0x7F, 0xF8, 0xF0, 0xF0, 0xF8, 0x7F, 0x1F,
  // number 1
  0x00, 0x00, 0x1C, 0xFE, 0xFF, 0xFF, 0x00, 0x00,
  0x00, 0x00, 0xE0, 0xFF, 0xFF, 0x7F, 0x60, 0x00,
  // number 2
  0x00, 0x1C, 0x1E, 0x07, 0x83, 0xC7, 0xFF, 0x7E,
  0xF0, 0xFC, 0xEE, 0xE7, 0xE3, 0x61, 0x70, 0x70,
  // number 3
  0x00, 0x0E, 0x0F, 0x87, 0xC3, 0xE7, 0xBF, 0x1E,
  0x70, 0xF8, 0xF8, 0xF0, 0xE0, 0xF1, 0x7F, 0x3F,
  // number 4
  0xC0, 0xF0, 0xFC, 0x8F, 0x83, 0xFF, 0xFE, 0xC0,
  0x03, 0x03, 0x03, 0x03, 0xFF, 0xFF, 0x7F, 0x00,
  // number 5
  0x00, 0xFE, 0xFE, 0xC7, 0xC7, 0xC7, 0xC7, 0x83,
  0x78, 0xF8, 0xF0, 0xE0, 0xE0, 0xF1, 0x7F, 0x3F,
  // number 6
  0xE0, 0xF8, 0xBC, 0xCE, 0xC7, 0xC3, 0x80, 0x00,
  0x3F, 0x7F, 0xF1, 0xE0, 0xE0, 0xF1, 0x7F, 0x3F,
  // number 7
  0x0E, 0x0F, 0x0F, 0x07, 0xC7, 0xF3, 0x7F, 0x0F,
  0x00, 0x00, 0xF0, 0xFE, 0x1F, 0x03, 0x00, 0x00,
  // number 8
  0x00, 0x7C, 0xFE, 0xE7, 0xC3, 0xE7, 0x7F, 0x3E,
  0x3E, 0x7F, 0xF3, 0xE1, 0xE1, 0xF3, 0x7F, 0x3E,
  // number 9
  0xFC, 0xFE, 0x8F, 0x07, 0x07, 0x8F, 0xFE, 0xFC,
  0x00, 0x01, 0xC3, 0xE3, 0x73, 0x3D, 0x1F, 0x07,
};



PROGMEM const unsigned char hudAssets_plus_mask[] = {
  // width, height
  8, 8,
  // power up stopFish
  0x1C, 0x3E, 0x22, 0x7F, 0x41, 0xFF, 0x4D, 0xFF,
  0x49, 0xFF, 0x22, 0x7F, 0x1C, 0x3E, 0x00, 0x1C,
  // power up shootFish
  0x60, 0xFC, 0xBC, 0xFE, 0x92, 0xFF, 0x65, 0xFF,
  0xA1, 0xFF, 0x52, 0xFF, 0x0C, 0x5E, 0x00, 0x0C,
  // power up protectFish
  0x1C, 0x3E, 0x22, 0x7F, 0x4D, 0xFF, 0x45, 0xFF,
  0x41, 0xFF, 0x22, 0x7F, 0x1C, 0x3E, 0x00, 0x1C,
  // power up extra life
  0x0E, 0x1F, 0x1F, 0x3F, 0x3F, 0x7F, 0x7E, 0xFF,
  0x3F, 0x7F, 0x1F, 0x3F, 0x0E, 0x1F, 0x00, 0x0E,
  // power up shockFish
  0x0C, 0x9F, 0x8F, 0xFF, 0xEF, 0xFF, 0x7F, 0xFF,
  0x3B, 0x7F, 0x19, 0x3F, 0x08, 0x1D, 0x00, 0x08,
  // power up magnetFish
  0x38, 0x7C, 0x7C, 0xFE, 0x6E, 0xFF, 0x75, 0xFF,
  0x3A, 0x7F, 0x14, 0x3E, 0x08, 0x1C, 0x00, 0x08,
};


PROGMEM const unsigned char bonusPoints_plus_mask[] = {
  // width, height
  13, 8,
  // +10
  0x00, 0x1C, 0x08, 0x3E, 0x1C, 0x3E, 0x08, 0x3E, 0x00, 0x7E, 0x24, 0x7F, 0x3E,
  0x7F, 0x20, 0x7F, 0x00, 0x7F, 0x3E, 0x7F, 0x22, 0x7F, 0x3E, 0x7F, 0x00, 0x7F,
  // +20
  0x00, 0x1C, 0x08, 0x3E, 0x1C, 0x3E, 0x08, 0x3E, 0x00, 0x7F, 0x3A, 0x7F, 0x2A,
  0x7F, 0x2E, 0x7F, 0x00, 0x7F, 0x3E, 0x7F, 0x22, 0x7F, 0x3E, 0x7F, 0x00, 0x7F,
  // +30
  0x00, 0x1C, 0x08, 0x3E, 0x1C, 0x3E, 0x08, 0x3E, 0x00, 0x7F, 0x22, 0x7F, 0x2A,
  0x7F, 0x3E, 0x7F, 0x00, 0x7F, 0x3E, 0x7F, 0x22, 0x7F, 0x3E, 0x7F, 0x00, 0x7F,
  // +40
  0x00, 0x1C, 0x08, 0x3E, 0x1C, 0x3E, 0x08, 0x3E, 0x00, 0x1F, 0x0E, 0x1F, 0x08,
  0x7F, 0x3E, 0x7F, 0x00, 0x7F, 0x3E, 0x7F, 0x22, 0x7F, 0x3E, 0x7F, 0x00, 0x7F,
  // +50
  0x00, 0x1C, 0x08, 0x3E, 0x1C, 0x3E, 0x08, 0x3E, 0x00, 0x7F, 0x2E, 0x7F, 0x2A,
  0x7F, 0x3A, 0x7F, 0x00, 0x7F, 0x3E, 0x7F, 0x22, 0x7F, 0x3E, 0x7F, 0x00, 0x7F,
};

PROGMEM const unsigned char seaWeedSmall[] = {
  // width, height
  8, 8,
  // frame 0
  0x00, 0xC0, 0x00, 0xE0, 0x00, 0xFC, 0x00, 0xF0,
  // frame 1
  0x00, 0xC0, 0x00, 0xE0, 0x00, 0xFC, 0x00, 0xF0,
  // frame 2
  0x40, 0x80, 0x60, 0x80, 0x70, 0x8C, 0x40, 0xB0,
  // frame 3
  0x40, 0xA0, 0x40, 0x84, 0x78, 0x80, 0x60, 0x90,
  // frame 4
  0x40, 0xA0, 0x48, 0xB0, 0x40, 0x90, 0x60, 0x80,
  // frame 5
  0x40, 0x80, 0x20, 0xC0, 0x38, 0xC0, 0x30, 0xC0,
  // frame 6
  0x00, 0xC0, 0x00, 0xE0, 0x00, 0xFC, 0x00, 0xF0,
  // frame 7
  0x10, 0xC0, 0x00, 0xC0, 0x20, 0xF8, 0x04, 0xE0,
};

PROGMEM const unsigned char seaWeedBig[] = {
  // width, height
  8, 56,
  // frame 0
  0x00, 0x00, 0x00, 0x08, 0xF0, 0xC0, 0x00, 0x00,
  0x00, 0xC0, 0xF0, 0x3E, 0x0F, 0xE0, 0x80, 0x00,
  0x00, 0x00, 0x07, 0x8F, 0xE0, 0x3C, 0x8F, 0x00,
  0x00, 0x00, 0x3F, 0x7F, 0x00, 0x80, 0xFF, 0x1C,
  0x00, 0xF0, 0xFC, 0x1E, 0x03, 0xF9, 0xE0, 0x00,
  0x00, 0x03, 0xC7, 0xF0, 0x3C, 0x0F, 0x07, 0x00,
  0x3E, 0xFF, 0xC1, 0x00, 0x7F, 0xFC, 0x80, 0x00,
  // frame 1
  0x00, 0x00, 0x00, 0x08, 0xF0, 0xC0, 0x00, 0x00,
  0x00, 0x00, 0xC0, 0xF0, 0x3F, 0x0F, 0xE0, 0x80,
  0x00, 0x00, 0x07, 0x8F, 0xE0, 0x3C, 0x87, 0x01,
  0x00, 0x3C, 0x7F, 0x03, 0x80, 0xFC, 0x1F, 0x00,
  0x00, 0xF0, 0xFC, 0x1F, 0x03, 0xF8, 0xE0, 0x00,
  0x00, 0xC7, 0xF0, 0x3C, 0x0F, 0x07, 0x00, 0x00,
  0x3E, 0xFF, 0xC1, 0x00, 0x7F, 0xFC, 0x80, 0x00,
  // frame 2
  0x00, 0x00, 0x00, 0x00, 0x08, 0xF0, 0xC0, 0x00,
  0x00, 0x00, 0xC0, 0xF0, 0x3E, 0x0F, 0xE0, 0x80,
  0x00, 0x07, 0x8F, 0xE0, 0x3C, 0x87, 0x01, 0x00,
  0x00, 0x3F, 0x7F, 0x00, 0x80, 0xFF, 0x1C, 0x00,
  0xF0, 0xFC, 0x1E, 0x03, 0xF9, 0xE0, 0x00, 0x00,
  0x03, 0xC7, 0xF0, 0x3C, 0x0F, 0x07, 0x00, 0x00,
  0x00, 0xFF, 0xFF, 0x00, 0x00, 0xFF, 0xFC, 0x00,
  // frame 3
  0x00, 0x00, 0x00, 0x00, 0x80, 0xF8, 0x40, 0x00,
  0x00, 0xC0, 0xF0, 0x3E, 0x0F, 0xE1, 0x80, 0x00,
  0x00, 0x07, 0x8F, 0xE0, 0x3C, 0x87, 0x01, 0x00,
  0x3E, 0x7F, 0x01, 0x80, 0xFC, 0x1F, 0x00, 0x00,
  0xF0, 0xFC, 0x1F, 0x03, 0xF8, 0xE0, 0x00, 0x00,
  0x00, 0x03, 0xC7, 0xF0, 0x3C, 0x0F, 0x07, 0x00,
  0x00, 0xFE, 0xFF, 0x01, 0x00, 0xFF, 0xFC, 0x00,
  // frame 4
  0x00, 0x00, 0x00, 0x00, 0xF0, 0xC8, 0x00, 0x00,
  0x00, 0xC0, 0xF0, 0x3E, 0x0F, 0xE0, 0x00, 0x00,
  0x00, 0x8F, 0xE0, 0x3C, 0x8F, 0x03, 0x00, 0x00,
  0x3F, 0x7F, 0x00, 0x80, 0xFF, 0x1C, 0x00, 0x00,
  0x00, 0xF0, 0xFC, 0x1F, 0x03, 0xF8, 0xE0, 0x00,
  0x00, 0x03, 0xC7, 0xF0, 0x3C, 0x0F, 0x07, 0x00,
  0x00, 0xC0, 0xFF, 0x1F, 0x00, 0xC0, 0xFF, 0x3C,
  // frame 5
  0x00, 0x00, 0x00, 0x80, 0xF0, 0x48, 0x00, 0x00,
  0xC0, 0xF0, 0x3E, 0x0F, 0xE1, 0x80, 0x00, 0x00,
  0x07, 0x8F, 0xE0, 0x3C, 0x87, 0x01, 0x00, 0x00,
  0x00, 0x3F, 0x7F, 0x00, 0x80, 0xFF, 0x1C, 0x00,
  0x00, 0xF0, 0xFC, 0x1F, 0x03, 0xF8, 0xE0, 0x00,
  0x00, 0x00, 0x03, 0xC7, 0xF0, 0x3C, 0x0F, 0x07,
  0x00, 0xC0, 0xFE, 0x1F, 0x01, 0xC0, 0xFF, 0x3C,
  // frame 6
  0x00, 0x00, 0x00, 0xF0, 0xC8, 0x00, 0x00, 0x00,
  0xC0, 0xF0, 0x3E, 0x0F, 0xE0, 0x80, 0x00, 0x00,
  0x00, 0x07, 0xCF, 0xE0, 0x3C, 0x87, 0x00, 0x00,
  0x00, 0x3F, 0x7F, 0x00, 0x80, 0xFF, 0x1C, 0x00,
  0x00, 0x00, 0xF0, 0xFC, 0x1F, 0x03, 0xF8, 0xE0,
  0x00, 0x00, 0x03, 0xC7, 0xF0, 0x3C, 0x0F, 0x07,
  0x00, 0xFE, 0xFF, 0x01, 0x00, 0xFF, 0xFC, 0x00,
  // frame 7
  0x00, 0x00, 0x00, 0xF8, 0xC0, 0x00, 0x00, 0x00,
  0x00, 0xC0, 0xF0, 0x3F, 0x0F, 0xE0, 0x80, 0x00,
  0x00, 0x07, 0x8F, 0xE0, 0x3C, 0x87, 0x01, 0x00,
  0x00, 0x00, 0x3F, 0x7F, 0x00, 0x80, 0xFF, 0x1C,
  0x00, 0x00, 0xF0, 0xFC, 0x1F, 0x03, 0xF8, 0xE0,
  0x00, 0x03, 0xC7, 0xF0, 0x3C, 0x0F, 0x07, 0x00,
  0x00, 0xFE, 0xFF, 0x01, 0x00, 0xFF, 0xFC, 0x00,
};


#define LANEOFFSET 4
#define JELLYSPAWN  400
#define JELLYSPAWN2 800
#define JELLYSPAWN3 1200
#define EELSPAWN    200
#define EELSPAWN2   400
#define EELSPAWN3   1000
#define FASTSPAWN   500
#define FASTSPAWN2  1000

#define LANE_SEP    25

int spawnTimer = 20;
int8_t laneRide = 0;
int fr = 60;
byte pu_current = 0;

const byte pu_spawn_order[] = {
  PU_SHOOTFISH, PU_TURNFISH,
  PU_MAGNETFISH, PU_POPFISH,
  PU_PROTECTFISH, PU_LIFEFISH,
  PU_SHOCKFISH, PU_STOPFISH,
};

struct SmallBubbles
{
  public:
    byte x;
    int y;
    byte speed;
    byte type;
    void resetPos(boolean test);
};

void SmallBubbles::resetPos(boolean test)
{
  x = random(0, 120 - (112*test));
  y = random(0, 64);
  speed = random(1, 4);
  type = random(0, 3);
}

SmallBubbles titleBubbles[16];

void drawBubbles(boolean inGame)
{
  for (byte i = 0; i < 16 -(10*inGame); i++)
  {
    if (arduboy.everyXFrames(3))titleBubbles[i].y = titleBubbles[i].y - titleBubbles[i].speed;
    if (titleBubbles[i].y < -8)titleBubbles[i].resetPos(inGame);
    sprites.drawPlusMask(titleBubbles[i].x, titleBubbles[i].y, smallBubbles_plus_mask, titleBubbles[i].type);
  }
}


void spawnWave()
{
  if (getPowerup(PU_STOPFISH) == PU_OFF)
    spawnTimer--;

  if (spawnTimer <= 0)
  {
    spawnTimer = SPAWN_DELAY + (180 / max(scorePlayer >> 8, 1));

    // Powerup spawns
    if (random(2) == 0)
    {
      createPowerUp(pu_spawn_order[pu_current]);
      pu_current = (++pu_current) % 8;
    }

    if (scorePlayer > 1500 && fr == 60)
    {
      fr = 70;
      arduboy.setFrameRate(70);
    }
    if (scorePlayer > 3000 && fr == 70)
    {
      fr = 80;
      arduboy.setFrameRate(80);
    }

    if (scorePlayer > JELLYSPAWN2)
      jellyMax = 10;
    if (scorePlayer > EELSPAWN2)
      eelMax = 3;
    if (scorePlayer > FASTSPAWN)
      createEnemy(ENEMY_FAST, (random(3) * LANE_SEP) + LANEOFFSET); // Fillers, tighten gap, faster moving
    if (scorePlayer > EELSPAWN)
      createEnemy(ENEMY_EEL, (random(3) * LANE_SEP) + LANEOFFSET); // Three possible eel lanes, not distruptor, just limits v movement
    if (scorePlayer > EELSPAWN3)
      createEnemy(ENEMY_EEL, 28 + LANEOFFSET); // Three possible eel lanes, not distruptor, just limits v movement
    if (scorePlayer > JELLYSPAWN)
    {
      byte pos = 0;
      if (trollyFish.y < 32)
        --laneRide;
      else
      {
        ++laneRide;
        pos = 1;
      }

      if (abs(laneRide) < 2)
        pos = random(2);
      else
        laneRide = 0;
      createEnemy(ENEMY_JELLY, (pos * 63) + LANEOFFSET); // Two possible jelly lanes, disruptors
    }

    if (scorePlayer > 2000)
      createEnemy(ENEMY_FAST, (random(3) * LANE_SEP) + LANEOFFSET); // Fillers, tighten gap, faster moving

    // There is always enough room between bad fish, jellyfish and eels are what forces a move
    if (scorePlayer < FASTSPAWN2)
      createEnemy(ENEMY_BAD, (random(3) * LANE_SEP) + LANEOFFSET); // Fish are fillers
    else
      createEnemy(ENEMY_FAST, (random(3) * LANE_SEP) + LANEOFFSET); // Fish are fillers
    if (scorePlayer > 50)
      createEnemy(ENEMY_BAD, (random(3) * LANE_SEP) + LANEOFFSET); // Extra fillers
  }
}

boolean checkGameOver()
{
  if (getPowerup(PU_PROTECTFISH)) // protected
    return false;

  Rect player = {.x = 20, .y = trollyFish.y, .width = trollyFish.width, .height = trollyFish.height};
  Rect enemy;
  for (byte i = 0; i < MAX_ENEMIES; i++)
  {
    enemy.x = enemyFish[i].x;
    enemy.y = enemyFish[i].y;
    enemy.width = enemyFish[i].width;
    enemy.height = enemyFish[i].height;

    // Don't check collisions if enemy is a bubble or dead
    if (enemyFish[i].type != ENEMY_BUBBLE && enemyFish[i].type != ENEMY_DEAD)
    {
      if (bubbleBullet.active)
      {
        Rect bubble = { .x = bubbleBullet.x, .y = bubbleBullet.y, .width = bubbleBullet.width, bubbleBullet.height };
        if (physics.collide(enemy, bubble))
        {
          switch (enemyFish[i].type)
          {
            case ENEMY_JELLY:
              numJellys--;
              giveBonus(enemyFish[i].x, enemyFish[i].y + 8, 3);
              break;
            case ENEMY_EEL:
              numEels--;
              giveBonus(enemyFish[i].x, enemyFish[i].y + 8, 5);
              break;
            case ENEMY_FAST:
              giveBonus(enemyFish[i].x, enemyFish[i].y + 8, 2);
              break;
            default:
              giveBonus(enemyFish[i].x, enemyFish[i].y + 8, 1);
          }
          arduboy.tunes.tone(200, 50);
          enemyFish[i].type = ENEMY_BUBBLE;
            
          bubbleBullet.active = false;
        }
      }
        
      if (physics.collide(enemy, player))
      {
        
        if (getPowerup(PU_LIFEFISH)) // extra life
        {
          arduboy.tunes.tone(280, 50);
          setPowerup(PU_LIFEFISH, PU_OFF);
          enemyFish[i].x -= 32;
          enemyFish[i].resetPos();
          trollyFish.blink = 36;
          return false;
        }
        arduboy.setFrameRate(60);
        fr = 60;
        for (byte note = 0 ; note < 30; note++)
        {
          arduboy.tunes.tone(400 - (note * 10), 300);
          delay(15);
        }
        return true;
      }
    }
  }
  return false;
};



void drawScore(byte scoreX, byte scoreY, byte fontType)
{
  char buf[10];
  //scorePlayer = arduboy.cpuLoad();
  ltoa(scorePlayer, buf, 10);
  char charLen = strlen(buf);
  char pad = 6 - charLen;

  //draw 0 padding
  for (byte i = 0; i < pad; i++)
  {
    switch (fontType)
    {
      case SCORE_SMALL_FONT:
        sprites.drawPlusMask(scoreX + (7 * i), scoreY, numbersSmall_plus_mask, 0);
        break;
      case SCORE_BIG_FONT:
        sprites.drawSelfMasked(scoreX + (10 * i), scoreY, numbersBig, 0);
        break;
    }
  }

  for (byte i = 0; i < charLen; i++)
  {
    char digit = buf[i];
    byte j;
    if (digit <= 48)
    {
      digit = 0;
    }
    else {
      digit -= 48;
      if (digit > 9) digit = 0;
    }

    for (byte z = 0; z < 10; z++)
    {
      if (digit == z) j = z;
    }
    switch (fontType)
    {
      case SCORE_SMALL_FONT:
        sprites.drawPlusMask(scoreX + (pad * 7) + (7 * i), scoreY, numbersSmall_plus_mask, digit);
        break;
      case SCORE_BIG_FONT:
        sprites.drawSelfMasked(scoreX + (pad * 10) + (10 * i), scoreY, numbersBig, digit);
        break;
    }
  }
}

void drawPowerUps()
{
  byte offset = 0;

  if (getPowerup(PU_STOPFISH))
  {
    sprites.drawPlusMask(1, 1, hudAssets_plus_mask, 0);
    offset += 8;
  }

  if (getPowerup(PU_SHOOTFISH) && pu_bubbles > 0)
  {
    sprites.drawPlusMask(1 + offset, 1, hudAssets_plus_mask, 1);
    offset += 8;
    sprites.drawPlusMask(1 + offset, 1, numbersSmall_plus_mask, pu_bubbles);
    offset += 8;
  }

  if (getPowerup(PU_PROTECTFISH))
  {
    sprites.drawPlusMask(1 + offset, 1, hudAssets_plus_mask, 2);
    offset += 8;
  }

  if (getPowerup(PU_LIFEFISH))
  {
    sprites.drawPlusMask(1 + offset, 1, hudAssets_plus_mask, 3);
    offset += 8;
  }

  if (getPowerup(PU_SHOCKFISH) && pu_shocks > 0)
  {
    sprites.drawPlusMask(1 + offset, 1, hudAssets_plus_mask, 4);
    offset += 8;
    sprites.drawPlusMask(1 + offset, 1, numbersSmall_plus_mask, pu_shocks);
    offset += 8;
  }

  if (getPowerup(PU_MAGNETFISH))
  {
    sprites.drawPlusMask(1 + offset, 1, hudAssets_plus_mask, 5);
    offset += 8;
  }
}

void drawWeed()
{
  if (arduboy.everyXFrames(8))
  {
    seaWeedFrames++;
    seaWeedFrames2++;
  }
  if (seaWeedFrames > 7 ) seaWeedFrames = 0;
  if (seaWeedFrames2 > 7 ) seaWeedFrames2 = 0;
  for (byte i = 1; i < 15; i++)
  {
    sprites.drawSelfMasked(8 * i, 56, seaWeedSmall, seaWeedFrames);
  }
  sprites.drawSelfMasked(0, 8, seaWeedBig, seaWeedFrames);
  sprites.drawSelfMasked(5, 8, seaWeedBig, seaWeedFrames2);
  sprites.drawSelfMasked(115, 8, seaWeedBig, seaWeedFrames);
  sprites.drawSelfMasked(120, 8, seaWeedBig, seaWeedFrames2);
}

struct Bonus
{
  int8_t x, y;
  byte amount;
  bool active;
};

Bonus bonus[MAX_ENEMIES];
byte numBonus = 0;

void initBonuses()
{
  for (byte i = 0; i < MAX_ENEMIES; ++i)
  {
    bonus[i].x = 0;
    bonus[i].y = 0;
    bonus[i].amount = 0;
    bonus[i].active = false;
  }
}

void giveBonus(int8_t x, int8_t y, byte amount)
{
  scorePlayer += amount * 10;
  for (byte i = 0; i < MAX_ENEMIES; ++i)
  {
    if (bonus[i].active == false)
    {
      bonus[i].active = true;
      bonus[i].x = x;
      bonus[i].y = y;
      bonus[i].amount = amount;
      ++numBonus;

      break;
    }
  }
}

void updateBonus()
{
  if (numBonus > 0 && arduboy.everyXFrames(2))
  {
    for (byte i = 0; i < MAX_ENEMIES; ++i)
    {
      if (bonus[i].active)
      {
        --bonus[i].y;

        sprites.drawPlusMask(bonus[i].x, bonus[i].y, bonusPoints_plus_mask, bonus[i].amount - 1);

        if (bonus[i].y < 0)
        {
          bonus[i].active = false;
          --numBonus;
        }
      }
    }
  }
}

#endif
